## firmware/spi_master/build/spi_master/Kconfig/boards/Kconfig.defconfig
```kconfig
# Load Zephyr board defconfig descriptions.
osource "/opt/nordic/ncs/v3.3.1/zephyr/boards/nordic/nrf54lm20dk/Kconfig.defconfig"
```

## firmware/spi_slave/build/Kconfig/boards/Kconfig.nrf54lm20dk.tmp
```kconfig
# Load board Kconfig descriptions.
osource "/opt/nordic/ncs/v3.3.1/zephyr/boards/nordic/nrf54lm20dk/Kconfig.nrf54lm20dk"
```
